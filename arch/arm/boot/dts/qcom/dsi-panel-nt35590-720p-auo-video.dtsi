/* Copyright (c) 2013, The Linux Foundation. All rights reserved.
 *
 * This program is free software; you can redistribute it and/or modify
 * it under the terms of the GNU General Public License version 2 and
 * only version 2 as published by the Free Software Foundation.
 *
 * This program is distributed in the hope that it will be useful,
 * but WITHOUT ANY WARRANTY; without even the implied warranty of
 * MERCHANTABILITY or FITNESS FOR A PARTICULAR PURPOSE.  See the
 * GNU General Public License for more details.
 */

/*---------------------------------------------------------------------------
 * This file is autogenerated file using gcdb parser. Please do not edit it.
 * Update input XML file to add a new entry or update variable in this file
 * VERSION = "1.0"
 *---------------------------------------------------------------------------*/
&mdss_mdp {
	dsi_nt35590_720_auo_vid: qcom,mdss_dsi_nt35590_720p_auo_video {
		qcom,mdss-dsi-panel-name = "NT35590 720p AUO video mode dsi panel";
		qcom,mdss-dsi-panel-controller = <&mdss_dsi0>;
		qcom,panel-supply-entries = <&dsi_panel_pwr_supply>;
		qcom,mdss-dsi-panel-type = "dsi_video_mode";
		qcom,mdss-dsi-panel-destination = "display_1";
		qcom,mdss-dsi-panel-framerate = <60>;
		qcom,mdss-dsi-virtual-channel-id = <0>;
		qcom,mdss-dsi-stream = <0>;
		qcom,mdss-dsi-panel-width = <720>;
		qcom,mdss-dsi-panel-height = <1280>;
		qcom,mdss-dsi-h-front-porch = <140>;
		qcom,mdss-dsi-h-back-porch = <164>;
		qcom,mdss-dsi-h-pulse-width = <8>;
		qcom,mdss-dsi-h-sync-skew = <0>;
		qcom,mdss-dsi-v-back-porch = <1>;
		qcom,mdss-dsi-v-front-porch = <6>;
		qcom,mdss-dsi-v-pulse-width = <1>;
		qcom,mdss-dsi-h-left-border = <0>;
		qcom,mdss-dsi-h-right-border = <0>;
		qcom,mdss-dsi-v-top-border = <0>;
		qcom,mdss-dsi-v-bottom-border = <0>;
		qcom,mdss-dsi-bpp = <24>;
		qcom,mdss-dsi-underflow-color = <0xff>;
		qcom,mdss-dsi-border-color = <0>;
		qcom,mdss-dsi-on-command = [29 01 00 00 00 00 02 ff ee
					29 01 00 00 00 00 02 26 08
					29 01 00 00 00 00 02 26 00
					29 01 00 00 10 00 02 ff 00
					29 01 00 00 00 00 02 ff 00
					29 01 00 00 00 00 02 fb 01
					29 01 00 00 10 00 02 ba 03
					29 01 00 00 00 00 02 c2 03
					29 01 00 00 00 00 02 ff 01
					29 01 00 00 00 00 02 fb 01
					29 01 00 00 00 00 02 00 4a
					29 01 00 00 00 00 02 01 33
					29 01 00 00 00 00 02 02 53
					29 01 00 00 00 00 02 03 55
					29 01 00 00 00 00 02 04 55
					29 01 00 00 00 00 02 05 33
					29 01 00 00 00 00 02 06 22
					29 01 00 00 00 00 02 08 56
					29 01 00 00 00 00 02 09 8f
					29 01 00 00 00 00 02 0b d2
					29 01 00 00 00 00 02 0c d2
					29 01 00 00 00 00 02 0d 2f
					29 01 00 00 00 00 02 0e 29
					29 01 00 00 00 00 02 36 73
					29 01 00 00 00 00 02 0f 0a
					29 01 00 00 00 00 02 11 80
					29 01 00 00 00 00 02 ff ee
					29 01 00 00 00 00 02 fb 01
					29 01 00 00 00 00 02 12 50
					29 01 00 00 00 00 02 13 02
					29 01 00 00 00 00 02 6a 60
					29 01 00 00 00 00 02 ff 05
					29 01 00 00 00 00 02 fb 01
					29 01 00 00 00 00 02 01 00
					29 01 00 00 00 00 02 02 82
					29 01 00 00 00 00 02 03 82
					29 01 00 00 00 00 02 04 82
					29 01 00 00 00 00 02 05 30
					29 01 00 00 00 00 02 06 33
					29 01 00 00 00 00 02 07 01
					29 01 00 00 00 00 02 08 00
					29 01 00 00 00 00 02 09 46
					29 01 00 00 00 00 02 0a 46
					29 01 00 00 00 00 02 0d 0b
					29 01 00 00 00 00 02 0e 1d
					29 01 00 00 00 00 02 0f 08
					29 01 00 00 00 00 02 10 53
					29 01 00 00 00 00 02 11 00
					29 01 00 00 00 00 02 12 00
					29 01 00 00 00 00 02 14 01
					29 01 00 00 00 00 02 15 00
					29 01 00 00 00 00 02 16 05
					29 01 00 00 00 00 02 17 00
					29 01 00 00 00 00 02 19 7f
					29 01 00 00 00 00 02 1a ff
					29 01 00 00 00 00 02 1b 0f
					29 01 00 00 00 00 02 1c 00
					29 01 00 00 00 00 02 1d 00
					29 01 00 00 00 00 02 1e 00
					29 01 00 00 00 00 02 1f 07
					29 01 00 00 00 00 02 20 00
					29 01 00 00 00 00 02 21 00
					29 01 00 00 00 00 02 22 55
					29 01 00 00 00 00 02 23 4d
					29 01 00 00 00 00 02 2d 02
					29 01 00 00 00 00 02 28 01
					29 01 00 00 00 00 02 2f 02
					29 01 00 00 00 00 02 83 01
					29 01 00 00 00 00 02 9e 58
					29 01 00 00 00 00 02 9f 6a
					29 01 00 00 00 00 02 a0 01
					29 01 00 00 00 00 02 a2 10
					29 01 00 00 00 00 02 bb 0a
					29 01 00 00 00 00 02 bc 0a
					29 01 00 00 00 00 02 32 08
					29 01 00 00 00 00 02 33 b8
					29 01 00 00 00 00 02 36 01
					29 01 00 00 00 00 02 37 00
					29 01 00 00 00 00 02 43 00
					29 01 00 00 00 00 02 4b 21
					29 01 00 00 00 00 02 4c 03
					29 01 00 00 00 00 02 50 21
					29 01 00 00 00 00 02 51 03
					29 01 00 00 00 00 02 58 21
					29 01 00 00 00 00 02 59 03
					29 01 00 00 00 00 02 5d 21
					29 01 00 00 00 00 02 5e 03
					29 01 00 00 00 00 02 6c 00
					29 01 00 00 00 00 02 6d 00
					29 01 00 00 00 00 02 fb 01
					29 01 00 00 00 00 02 ff 01
					29 01 00 00 00 00 02 fb 01
					29 01 00 00 00 00 02 75 00
					29 01 00 00 00 00 02 76 4d
					29 01 00 00 00 00 02 77 00
					29 01 00 00 00 00 02 78 84
					29 01 00 00 00 00 02 79 00
					29 01 00 00 00 00 02 7a b5
					29 01 00 00 00 00 02 7b 00
					29 01 00 00 00 00 02 7c d5
					29 01 00 00 00 00 02 7d 00
					29 01 00 00 00 00 02 7e ef
					29 01 00 00 00 00 02 7f 01
					29 01 00 00 00 00 02 80 04
					29 01 00 00 00 00 02 81 01
					29 01 00 00 00 00 02 82 16
					29 01 00 00 00 00 02 83 01
					29 01 00 00 00 00 02 84 26
					29 01 00 00 00 00 02 85 01
					29 01 00 00 00 00 02 86 35
					29 01 00 00 00 00 02 87 01
					29 01 00 00 00 00 02 88 63
					29 01 00 00 00 00 02 89 01
					29 01 00 00 00 00 02 8a 88
					29 01 00 00 00 00 02 8b 01
					29 01 00 00 00 00 02 8c c0
					29 01 00 00 00 00 02 8d 01
					29 01 00 00 00 00 02 8e eb
					29 01 00 00 00 00 02 8f 02
					29 01 00 00 00 00 02 90 2b
					29 01 00 00 00 00 02 91 02
					29 01 00 00 00 00 02 92 5d
					29 01 00 00 00 00 02 93 02
					29 01 00 00 00 00 02 94 5f
					29 01 00 00 00 00 02 95 02
					29 01 00 00 00 00 02 96 8a
					29 01 00 00 00 00 02 97 02
					29 01 00 00 00 00 02 98 b8
					29 01 00 00 00 00 02 99 02
					29 01 00 00 00 00 02 9a d6
					29 01 00 00 00 00 02 9b 02
					29 01 00 00 00 00 02 9c fe
					29 01 00 00 00 00 02 9d 03
					29 01 00 00 00 00 02 9e 1a
					29 01 00 00 00 00 02 9f 03
					29 01 00 00 00 00 02 a0 3f
					29 01 00 00 00 00 02 a2 03
					29 01 00 00 00 00 02 a3 4b
					29 01 00 00 00 00 02 a4 03
					29 01 00 00 00 00 02 a5 58
					29 01 00 00 00 00 02 a6 03
					29 01 00 00 00 00 02 a7 66
					29 01 00 00 00 00 02 a9 03
					29 01 00 00 00 00 02 aa 76
					29 01 00 00 00 00 02 ab 03
					29 01 00 00 00 00 02 ac 89
					29 01 00 00 00 00 02 ad 03
					29 01 00 00 00 00 02 ae 9e
					29 01 00 00 00 00 02 af 03
					29 01 00 00 00 00 02 b0 b5
					29 01 00 00 00 00 02 b1 03
					29 01 00 00 00 00 02 b2 b9
					29 01 00 00 00 00 02 b3 00
					29 01 00 00 00 00 02 b4 4d
					29 01 00 00 00 00 02 b5 00
					29 01 00 00 00 00 02 b6 84
					29 01 00 00 00 00 02 b7 00
					29 01 00 00 00 00 02 b8 b5
					29 01 00 00 00 00 02 b9 00
					29 01 00 00 00 00 02 ba d5
					29 01 00 00 00 00 02 bb 00
					29 01 00 00 00 00 02 bc ef
					29 01 00 00 00 00 02 bd 01
					29 01 00 00 00 00 02 be 04
					29 01 00 00 00 00 02 bf 01
					29 01 00 00 00 00 02 c0 16
					29 01 00 00 00 00 02 c1 01
					29 01 00 00 00 00 02 c2 26
					29 01 00 00 00 00 02 c3 01
					29 01 00 00 00 00 02 c4 35
					29 01 00 00 00 00 02 c5 01
					29 01 00 00 00 00 02 c6 63
					29 01 00 00 00 00 02 c7 01
					29 01 00 00 00 00 02 c8 88
					29 01 00 00 00 00 02 c9 01
					29 01 00 00 00 00 02 ca c0
					29 01 00 00 00 00 02 cb 01
					29 01 00 00 00 00 02 cc eb
					29 01 00 00 00 00 02 cd 02
					29 01 00 00 00 00 02 ce 2b
					29 01 00 00 00 00 02 cf 02
					29 01 00 00 00 00 02 d0 5d
					29 01 00 00 00 00 02 d1 02
					29 01 00 00 00 00 02 d2 5f
					29 01 00 00 00 00 02 d3 02
					29 01 00 00 00 00 02 d4 8a
					29 01 00 00 00 00 02 d5 02
					29 01 00 00 00 00 02 d6 b8
					29 01 00 00 00 00 02 d7 02
					29 01 00 00 00 00 02 d8 d6
					29 01 00 00 00 00 02 d9 02
					29 01 00 00 00 00 02 da fe
					29 01 00 00 00 00 02 db 03
					29 01 00 00 00 00 02 dc 1a
					29 01 00 00 00 00 02 dd 03
					29 01 00 00 00 00 02 de 3f
					29 01 00 00 00 00 02 df 03
					29 01 00 00 00 00 02 e0 4b
					29 01 00 00 00 00 02 e1 03
					29 01 00 00 00 00 02 e2 58
					29 01 00 00 00 00 02 e3 03
					29 01 00 00 00 00 02 e4 66
					29 01 00 00 00 00 02 e5 03
					29 01 00 00 00 00 02 e6 76
					29 01 00 00 00 00 02 e7 03
					29 01 00 00 00 00 02 e8 89
					29 01 00 00 00 00 02 e9 03
					29 01 00 00 00 00 02 ea 9e
					29 01 00 00 00 00 02 eb 03
					29 01 00 00 00 00 02 ec b5
					29 01 00 00 00 00 02 ed 03
					29 01 00 00 00 00 02 ee b9
					29 01 00 00 00 00 02 ef 00
					29 01 00 00 00 00 02 f0 4d
					29 01 00 00 00 00 02 f1 00
					29 01 00 00 00 00 02 f2 84
					29 01 00 00 00 00 02 f3 00
					29 01 00 00 00 00 02 f4 b5
					29 01 00 00 00 00 02 f5 00
					29 01 00 00 00 00 02 f6 d5
					29 01 00 00 00 00 02 f7 00
					29 01 00 00 00 00 02 f8 ef
					29 01 00 00 00 00 02 f9 01
					29 01 00 00 00 00 02 fa 04
					29 01 00 00 00 00 02 ff 02
					29 01 00 00 00 00 02 00 01
					29 01 00 00 00 00 02 01 16
					29 01 00 00 00 00 02 02 01
					29 01 00 00 00 00 02 03 26
					29 01 00 00 00 00 02 04 01
					29 01 00 00 00 00 02 05 35
					29 01 00 00 00 00 02 06 01
					29 01 00 00 00 00 02 07 63
					29 01 00 00 00 00 02 08 01
					29 01 00 00 00 00 02 09 88
					29 01 00 00 00 00 02 0a 01
					29 01 00 00 00 00 02 0b c0
					29 01 00 00 00 00 02 0c 01
					29 01 00 00 00 00 02 0d eb
					29 01 00 00 00 00 02 0e 02
					29 01 00 00 00 00 02 0f 2b
					29 01 00 00 00 00 02 10 02
					29 01 00 00 00 00 02 11 5d
					29 01 00 00 00 00 02 12 02
					29 01 00 00 00 00 02 13 5f
					29 01 00 00 00 00 02 14 02
					29 01 00 00 00 00 02 15 8a
					29 01 00 00 00 00 02 16 02
					29 01 00 00 00 00 02 17 b8
					29 01 00 00 00 00 02 18 02
					29 01 00 00 00 00 02 19 d6
					29 01 00 00 00 00 02 1a 02
					29 01 00 00 00 00 02 1b fe
					29 01 00 00 00 00 02 1c 03
					29 01 00 00 00 00 02 1d 1a
					29 01 00 00 00 00 02 1e 03
					29 01 00 00 00 00 02 1f 3f
					29 01 00 00 00 00 02 20 03
					29 01 00 00 00 00 02 21 4b
					29 01 00 00 00 00 02 22 03
					29 01 00 00 00 00 02 23 58
					29 01 00 00 00 00 02 24 03
					29 01 00 00 00 00 02 25 66
					29 01 00 00 00 00 02 26 03
					29 01 00 00 00 00 02 27 76
					29 01 00 00 00 00 02 28 03
					29 01 00 00 00 00 02 29 89
					29 01 00 00 00 00 02 2a 03
					29 01 00 00 00 00 02 2b 9e
					29 01 00 00 00 00 02 2d 03
					29 01 00 00 00 00 02 2f b5
					29 01 00 00 00 00 02 30 03
					29 01 00 00 00 00 02 31 b9
					29 01 00 00 00 00 02 32 00
					29 01 00 00 00 00 02 33 4d
					29 01 00 00 00 00 02 34 00
					29 01 00 00 00 00 02 35 84
					29 01 00 00 00 00 02 36 00
					29 01 00 00 00 00 02 37 b5
					29 01 00 00 00 00 02 38 00
					29 01 00 00 00 00 02 39 d5
					29 01 00 00 00 00 02 3a 00
					29 01 00 00 00 00 02 3b ef
					29 01 00 00 00 00 02 3d 01
					29 01 00 00 00 00 02 3f 04
					29 01 00 00 00 00 02 40 01
					29 01 00 00 00 00 02 41 16
					29 01 00 00 00 00 02 42 01
					29 01 00 00 00 00 02 43 26
					29 01 00 00 00 00 02 44 01
					29 01 00 00 00 00 02 45 35
					29 01 00 00 00 00 02 46 01
					29 01 00 00 00 00 02 47 63
					29 01 00 00 00 00 02 48 01
					29 01 00 00 00 00 02 49 88
					29 01 00 00 00 00 02 4a 01
					29 01 00 00 00 00 02 4b c0
					29 01 00 00 00 00 02 4c 01
					29 01 00 00 00 00 02 4d eb
					29 01 00 00 00 00 02 4e 02
					29 01 00 00 00 00 02 4f 2b
					29 01 00 00 00 00 02 50 02
					29 01 00 00 00 00 02 51 5d
					29 01 00 00 00 00 02 52 02
					29 01 00 00 00 00 02 53 5f
					29 01 00 00 00 00 02 54 02
					29 01 00 00 00 00 02 55 8a
					29 01 00 00 00 00 02 56 02
					29 01 00 00 00 00 02 58 b8
					29 01 00 00 00 00 02 59 02
					29 01 00 00 00 00 02 5a d6
					29 01 00 00 00 00 02 5b 02
					29 01 00 00 00 00 02 5c fe
					29 01 00 00 00 00 02 5d 03
					29 01 00 00 00 00 02 5e 1a
					29 01 00 00 00 00 02 5f 03
					29 01 00 00 00 00 02 60 3f
					29 01 00 00 00 00 02 61 03
					29 01 00 00 00 00 02 62 4b
					29 01 00 00 00 00 02 63 03
					29 01 00 00 00 00 02 64 58
					29 01 00 00 00 00 02 65 03
					29 01 00 00 00 00 02 66 66
					29 01 00 00 00 00 02 67 03
					29 01 00 00 00 00 02 68 76
					29 01 00 00 00 00 02 69 03
					29 01 00 00 00 00 02 6a 89
					29 01 00 00 00 00 02 6b 03
					29 01 00 00 00 00 02 6c 9e
					29 01 00 00 00 00 02 6d 03
					29 01 00 00 00 00 02 6e b5
					29 01 00 00 00 00 02 6f 03
					29 01 00 00 00 00 02 70 b9
					29 01 00 00 00 00 02 71 00
					29 01 00 00 00 00 02 72 4d
					29 01 00 00 00 00 02 73 00
					29 01 00 00 00 00 02 74 84
					29 01 00 00 00 00 02 75 00
					29 01 00 00 00 00 02 76 b5
					29 01 00 00 00 00 02 77 00
					29 01 00 00 00 00 02 78 d5
					29 01 00 00 00 00 02 79 00
					29 01 00 00 00 00 02 7a ef
					29 01 00 00 00 00 02 7b 01
					29 01 00 00 00 00 02 7c 04
					29 01 00 00 00 00 02 7d 01
					29 01 00 00 00 00 02 7e 16
					29 01 00 00 00 00 02 7f 01
					29 01 00 00 00 00 02 80 26
					29 01 00 00 00 00 02 81 01
					29 01 00 00 00 00 02 82 35
					29 01 00 00 00 00 02 83 01
					29 01 00 00 00 00 02 84 63
					29 01 00 00 00 00 02 85 01
					29 01 00 00 00 00 02 86 88
					29 01 00 00 00 00 02 87 01
					29 01 00 00 00 00 02 88 c0
					29 01 00 00 00 00 02 89 01
					29 01 00 00 00 00 02 8a eb
					29 01 00 00 00 00 02 8b 02
					29 01 00 00 00 00 02 8c 2b
					29 01 00 00 00 00 02 8d 02
					29 01 00 00 00 00 02 8e 5d
					29 01 00 00 00 00 02 8f 02
					29 01 00 00 00 00 02 90 5f
					29 01 00 00 00 00 02 91 02
					29 01 00 00 00 00 02 92 8a
					29 01 00 00 00 00 02 93 02
					29 01 00 00 00 00 02 94 b8
					29 01 00 00 00 00 02 95 02
					29 01 00 00 00 00 02 96 d6
					29 01 00 00 00 00 02 97 02
					29 01 00 00 00 00 02 98 fe
					29 01 00 00 00 00 02 99 03
					29 01 00 00 00 00 02 9a 1a
					29 01 00 00 00 00 02 9b 03
					29 01 00 00 00 00 02 9c 3f
					29 01 00 00 00 00 02 9d 03
					29 01 00 00 00 00 02 9e 4b
					29 01 00 00 00 00 02 9f 03
					29 01 00 00 00 00 02 a0 58
					29 01 00 00 00 00 02 a2 03
					29 01 00 00 00 00 02 a3 66
					29 01 00 00 00 00 02 a4 03
					29 01 00 00 00 00 02 a5 76
					29 01 00 00 00 00 02 a6 03
					29 01 00 00 00 00 02 a7 89
					29 01 00 00 00 00 02 a9 03
					29 01 00 00 00 00 02 aa 9e
					29 01 00 00 00 00 02 ab 03
					29 01 00 00 00 00 02 ac b5
					29 01 00 00 00 00 02 ad 03
					29 01 00 00 00 00 02 ae b9
					29 01 00 00 00 00 02 af 00
					29 01 00 00 00 00 02 b0 4d
					29 01 00 00 00 00 02 b1 00
					29 01 00 00 00 00 02 b2 84
					29 01 00 00 00 00 02 b3 00
					29 01 00 00 00 00 02 b4 b5
					29 01 00 00 00 00 02 b5 00
					29 01 00 00 00 00 02 b6 d5
					29 01 00 00 00 00 02 b7 00
					29 01 00 00 00 00 02 b8 ef
					29 01 00 00 00 00 02 b9 01
					29 01 00 00 00 00 02 ba 04
					29 01 00 00 00 00 02 bb 01
					29 01 00 00 00 00 02 bc 16
					29 01 00 00 00 00 02 bd 01
					29 01 00 00 00 00 02 be 26
					29 01 00 00 00 00 02 bf 01
					29 01 00 00 00 00 02 c0 35
					29 01 00 00 00 00 02 c1 01
					29 01 00 00 00 00 02 c2 63
					29 01 00 00 00 00 02 c3 01
					29 01 00 00 00 00 02 c4 88
					29 01 00 00 00 00 02 c5 01
					29 01 00 00 00 00 02 c6 c0
					29 01 00 00 00 00 02 c7 01
					29 01 00 00 00 00 02 c8 eb
					29 01 00 00 00 00 02 c9 02
					29 01 00 00 00 00 02 ca 2b
					29 01 00 00 00 00 02 cb 02
					29 01 00 00 00 00 02 cc 5d
					29 01 00 00 00 00 02 cd 02
					29 01 00 00 00 00 02 ce 5f
					29 01 00 00 00 00 02 cf 02
					29 01 00 00 00 00 02 d0 8a
					29 01 00 00 00 00 02 d1 02
					29 01 00 00 00 00 02 d2 b8
					29 01 00 00 00 00 02 d3 02
					29 01 00 00 00 00 02 d4 d6
					29 01 00 00 00 00 02 d5 02
					29 01 00 00 00 00 02 d6 fe
					29 01 00 00 00 00 02 d7 03
					29 01 00 00 00 00 02 d8 1a
					29 01 00 00 00 00 02 d9 03
					29 01 00 00 00 00 02 da 3f
					29 01 00 00 00 00 02 db 03
					29 01 00 00 00 00 02 dc 4b
					29 01 00 00 00 00 02 dd 03
					29 01 00 00 00 00 02 de 58
					29 01 00 00 00 00 02 df 03
					29 01 00 00 00 00 02 e0 66
					29 01 00 00 00 00 02 e1 03
					29 01 00 00 00 00 02 e2 76
					29 01 00 00 00 00 02 e3 03
					29 01 00 00 00 00 02 e4 89
					29 01 00 00 00 00 02 e5 03
					29 01 00 00 00 00 02 e6 9e
					29 01 00 00 00 00 02 e7 03
					29 01 00 00 00 00 02 e8 b5
					29 01 00 00 00 00 02 e9 03
					29 01 00 00 00 00 02 ea b9
					29 01 00 00 00 00 02 ff 04
					29 01 00 00 00 00 02 fb 01
					29 01 00 00 00 00 02 09 20
					29 01 00 00 00 00 02 0a 04
					29 01 00 00 00 00 02 ff 00
					29 01 00 00 78 00 02 11 00
					29 01 00 00 00 00 02 ff 01
					29 01 00 00 00 00 02 00 4a
					29 01 00 00 00 00 02 ff 00
					29 01 00 00 00 00 02 ff ee
					29 01 00 00 00 00 02 12 50
					29 01 00 00 00 00 02 13 02
					29 01 00 00 00 00 02 6a 60
					29 01 00 00 00 00 02 ff 00
					29 01 00 00 14 00 02 29 00
					29 01 00 00 78 00 02 53 2c];
		qcom,mdss-dsi-off-command = [05 01 00 00 32 00 02 28 00
					05 01 00 00 78 00 02 10 00];
		qcom,mdss-dsi-on-command-state = "dsi_lp_mode";
		qcom,mdss-dsi-off-command-state = "dsi_hs_mode";
		qcom,mdss-dsi-panel-status-check-mode = "bta_check";
		qcom,dynamic-mode-switch-enabled;
		qcom,video-to-cmd-mode-switch-commands = [15 01 00 00 14 00 02 C2 0B
					15 01 00 00 00 00 02 C2 08];
		qcom,cmd-to-video-mode-switch-commands = [15 01 00 00 00 00 02 C2 03];
		qcom,mdss-dsi-h-sync-pulse = <1>;
		qcom,mdss-dsi-traffic-mode = "burst_mode";
		qcom,mdss-dsi-bllp-eof-power-mode;
		qcom,mdss-dsi-bllp-power-mode;
		qcom,mdss-dsi-lane-0-state;
		qcom,mdss-dsi-lane-1-state;
		qcom,mdss-dsi-lane-2-state;
		qcom,mdss-dsi-lane-3-state;
		qcom,mdss-dsi-panel-timings = [7d 25 1d 00 37 33 22 27 1e 03 04 00];
		qcom,mdss-dsi-t-clk-post = <0x20>;
		qcom,mdss-dsi-t-clk-pre = <0x2c>;
		qcom,mdss-dsi-bl-min-level = <10>;
		qcom,mdss-dsi-bl-max-level = <160>;
		qcom,mdss-dsi-dma-trigger = "trigger_sw";
		qcom,mdss-dsi-mdp-trigger = "none";
		qcom,mdss-dsi-bl-pmic-control-type = "bl_ctrl_dcs";
		qcom,mdss-dsi-reset-sequence = <1 20>, <0 1>, <1 20>;
		qcom,mdss-pan-physical-width-dimension = <59>;
		qcom,mdss-pan-physical-height-dimension = <104>;
		qcom,mdss-dsi-pan-enable-dynamic-fps;
		qcom,mdss-dsi-pan-fps-update = "dfps_immediate_porch_mode";
		qcom,mdss-dsi-min-refresh-rate = <45>;
		qcom,cont-splash-enabled;
	};
};
