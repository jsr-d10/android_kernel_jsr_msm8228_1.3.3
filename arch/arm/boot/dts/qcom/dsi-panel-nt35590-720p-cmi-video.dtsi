/* Copyright (c) 2013, The Linux Foundation. All rights reserved.
 *
 * This program is free software; you can redistribute it and/or modify
 * it under the terms of the GNU General Public License version 2 and
 * only version 2 as published by the Free Software Foundation.
 *
 * This program is distributed in the hope that it will be useful,
 * but WITHOUT ANY WARRANTY; without even the implied warranty of
 * MERCHANTABILITY or FITNESS FOR A PARTICULAR PURPOSE.  See the
 * GNU General Public License for more details.
 */

/*---------------------------------------------------------------------------
 * This file is autogenerated file using gcdb parser. Please do not edit it.
 * Update input XML file to add a new entry or update variable in this file
 * VERSION = "1.0"
 *---------------------------------------------------------------------------*/
&mdss_mdp {
	dsi_nt35590_720_cmi_vid: qcom,mdss_dsi_nt35590_720p_cmi_video {
		qcom,mdss-dsi-panel-name = "NT35590 720p CMI video mode dsi panel";
		qcom,mdss-dsi-panel-controller = <&mdss_dsi0>;
		qcom,panel-supply-entries = <&dsi_panel_pwr_supply>;
		qcom,mdss-dsi-panel-type = "dsi_video_mode";
		qcom,mdss-dsi-panel-destination = "display_1";
		qcom,mdss-dsi-panel-framerate = <60>;
		qcom,mdss-dsi-virtual-channel-id = <0>;
		qcom,mdss-dsi-stream = <0>;
		qcom,mdss-dsi-panel-width = <720>;
		qcom,mdss-dsi-panel-height = <1280>;
		qcom,mdss-dsi-h-front-porch = <140>;
		qcom,mdss-dsi-h-back-porch = <164>;
		qcom,mdss-dsi-h-pulse-width = <8>;
		qcom,mdss-dsi-h-sync-skew = <0>;
		qcom,mdss-dsi-v-back-porch = <1>;
		qcom,mdss-dsi-v-front-porch = <6>;
		qcom,mdss-dsi-v-pulse-width = <1>;
		qcom,mdss-dsi-h-left-border = <0>;
		qcom,mdss-dsi-h-right-border = <0>;
		qcom,mdss-dsi-v-top-border = <0>;
		qcom,mdss-dsi-v-bottom-border = <0>;
		qcom,mdss-dsi-bpp = <24>;
		qcom,mdss-dsi-underflow-color = <0xff>;
		qcom,mdss-dsi-border-color = <0>;
		qcom,mdss-dsi-on-command = [29 01 00 00 00 00 02 ff ee
					29 01 00 00 00 00 02 26 08
					29 01 00 00 00 00 02 26 00
					29 01 00 00 10 00 02 ff 00
					29 01 00 00 10 00 02 ff ee
					29 01 00 00 00 00 02 fb 01
					29 01 00 00 00 00 02 12 50
					29 01 00 00 00 00 02 13 02
					29 01 00 00 00 00 02 6a 60
					29 01 00 00 00 00 02 ff 00
					29 01 00 00 00 00 02 ba 03
					29 01 00 00 00 00 02 c2 03
					29 01 00 00 00 00 02 ff 01
					29 01 00 00 00 00 02 00 3a
					29 01 00 00 00 00 02 01 33
					29 01 00 00 00 00 02 02 53
					29 01 00 00 00 00 02 09 85
					29 01 00 00 00 00 02 0e 25
					29 01 00 00 00 00 02 0f 0a
					29 01 00 00 00 00 02 0b 97
					29 01 00 00 00 00 02 0c 97
					29 01 00 00 00 00 02 11 8a
					29 01 00 00 00 00 02 36 7b
					29 01 00 00 00 00 02 71 2c
					29 01 00 00 00 00 02 ff 05
					29 01 00 00 00 00 02 01 00
					29 01 00 00 00 00 02 02 8d
					29 01 00 00 00 00 02 03 8d
					29 01 00 00 00 00 02 04 8d
					29 01 00 00 00 00 02 05 30
					29 01 00 00 00 00 02 06 33
					29 01 00 00 00 00 02 07 77
					29 01 00 00 00 00 02 08 00
					29 01 00 00 00 00 02 09 00
					29 01 00 00 00 00 02 0a 00
					29 01 00 00 00 00 02 0b 80
					29 01 00 00 00 00 02 0c c8
					29 01 00 00 00 00 02 0d 00
					29 01 00 00 00 00 02 0e 1b
					29 01 00 00 00 00 02 0f 07
					29 01 00 00 00 00 02 10 57
					29 01 00 00 00 00 02 11 00
					29 01 00 00 00 00 02 12 00
					29 01 00 00 00 00 02 13 1e
					29 01 00 00 00 00 02 14 00
					29 01 00 00 00 00 02 15 1a
					29 01 00 00 00 00 02 16 05
					29 01 00 00 00 00 02 17 00
					29 01 00 00 00 00 02 18 1e
					29 01 00 00 00 00 02 19 ff
					29 01 00 00 00 00 02 1a 00
					29 01 00 00 00 00 02 1b fc
					29 01 00 00 00 00 02 1c 80
					29 01 00 00 00 00 02 1d 00
					29 01 00 00 00 00 02 1e 10
					29 01 00 00 00 00 02 1f 77
					29 01 00 00 00 00 02 20 00
					29 01 00 00 00 00 02 21 00
					29 01 00 00 00 00 02 22 55
					29 01 00 00 00 00 02 23 0d
					29 01 00 00 00 00 02 31 a0
					29 01 00 00 00 00 02 32 00
					29 01 00 00 00 00 02 33 b8
					29 01 00 00 00 00 02 34 bb
					29 01 00 00 00 00 02 35 11
					29 01 00 00 00 00 02 36 01
					29 01 00 00 00 00 02 37 0b
					29 01 00 00 00 00 02 38 01
					29 01 00 00 00 00 02 39 0b
					29 01 00 00 00 00 02 44 08
					29 01 00 00 00 00 02 45 80
					29 01 00 00 00 00 02 46 cc
					29 01 00 00 00 00 02 47 04
					29 01 00 00 00 00 02 48 00
					29 01 00 00 00 00 02 49 00
					29 01 00 00 00 00 02 4a 01
					29 01 00 00 00 00 02 6c 03
					29 01 00 00 00 00 02 6d 03
					29 01 00 00 00 00 02 6e 2f
					29 01 00 00 00 00 02 43 00
					29 01 00 00 00 00 02 4b 23
					29 01 00 00 00 00 02 4c 01
					29 01 00 00 00 00 02 50 23
					29 01 00 00 00 00 02 51 01
					29 01 00 00 00 00 02 58 23
					29 01 00 00 00 00 02 59 01
					29 01 00 00 00 00 02 5d 23
					29 01 00 00 00 00 02 5e 01
					29 01 00 00 00 00 02 62 23
					29 01 00 00 00 00 02 63 01
					29 01 00 00 00 00 02 67 23
					29 01 00 00 00 00 02 68 01
					29 01 00 00 00 00 02 89 00
					29 01 00 00 00 00 02 8d 01
					29 01 00 00 00 00 02 8e 64
					29 01 00 00 00 00 02 8f 20
					29 01 00 00 00 00 02 97 8e
					29 01 00 00 00 00 02 82 8c
					29 01 00 00 00 00 02 83 02
					29 01 00 00 00 00 02 bb 0a
					29 01 00 00 00 00 02 bc 0a
					29 01 00 00 00 00 02 24 25
					29 01 00 00 00 00 02 25 55
					29 01 00 00 00 00 02 26 05
					29 01 00 00 00 00 02 27 23
					29 01 00 00 00 00 02 28 01
					29 01 00 00 00 00 02 29 31
					29 01 00 00 00 00 02 2a 5d
					29 01 00 00 00 00 02 2b 01
					29 01 00 00 00 00 02 2f 00
					29 01 00 00 00 00 02 30 10
					29 01 00 00 00 00 02 a7 12
					29 01 00 00 00 00 02 2d 03
					29 01 00 00 00 00 02 ff 01
					29 01 00 00 00 00 02 75 00
					29 01 00 00 00 00 02 76 42
					29 01 00 00 00 00 02 77 00
					29 01 00 00 00 00 02 78 51
					29 01 00 00 00 00 02 79 00
					29 01 00 00 00 00 02 7a 6b
					29 01 00 00 00 00 02 7b 00
					29 01 00 00 00 00 02 7c 81
					29 01 00 00 00 00 02 7d 00
					29 01 00 00 00 00 02 7e 94
					29 01 00 00 00 00 02 7f 00
					29 01 00 00 00 00 02 80 a5
					29 01 00 00 00 00 02 81 00
					29 01 00 00 00 00 02 82 b3
					29 01 00 00 00 00 02 83 00
					29 01 00 00 00 00 02 84 c1
					29 01 00 00 00 00 02 85 00
					29 01 00 00 00 00 02 86 cd
					29 01 00 00 00 00 02 87 00
					29 01 00 00 00 00 02 88 f9
					29 01 00 00 00 00 02 89 01
					29 01 00 00 00 00 02 8a 1f
					29 01 00 00 00 00 02 8b 01
					29 01 00 00 00 00 02 8c 59
					29 01 00 00 00 00 02 8d 01
					29 01 00 00 00 00 02 8e 85
					29 01 00 00 00 00 02 8f 01
					29 01 00 00 00 00 02 90 d1
					29 01 00 00 00 00 02 91 02
					29 01 00 00 00 00 02 92 0c
					29 01 00 00 00 00 02 93 02
					29 01 00 00 00 00 02 94 0e
					29 01 00 00 00 00 02 95 02
					29 01 00 00 00 00 02 96 44
					29 01 00 00 00 00 02 97 02
					29 01 00 00 00 00 02 98 80
					29 01 00 00 00 00 02 99 02
					29 01 00 00 00 00 02 9a a6
					29 01 00 00 00 00 02 9b 02
					29 01 00 00 00 00 02 9c d3
					29 01 00 00 00 00 02 9d 02
					29 01 00 00 00 00 02 9e f4
					29 01 00 00 00 00 02 9f 03
					29 01 00 00 00 00 02 a0 1e
					29 01 00 00 00 00 02 a2 03
					29 01 00 00 00 00 02 a3 29
					29 01 00 00 00 00 02 a4 03
					29 01 00 00 00 00 02 a5 36
					29 01 00 00 00 00 02 a6 03
					29 01 00 00 00 00 02 a7 44
					29 01 00 00 00 00 02 a9 03
					29 01 00 00 00 00 02 aa 57
					29 01 00 00 00 00 02 ab 03
					29 01 00 00 00 00 02 ac 68
					29 01 00 00 00 00 02 ad 03
					29 01 00 00 00 00 02 ae 7a
					29 01 00 00 00 00 02 af 03
					29 01 00 00 00 00 02 b0 89
					29 01 00 00 00 00 02 b1 03
					29 01 00 00 00 00 02 b2 95
					29 01 00 00 00 00 02 b3 00
					29 01 00 00 00 00 02 b4 42
					29 01 00 00 00 00 02 b5 00
					29 01 00 00 00 00 02 b6 51
					29 01 00 00 00 00 02 b7 00
					29 01 00 00 00 00 02 b8 6b
					29 01 00 00 00 00 02 b9 00
					29 01 00 00 00 00 02 ba 81
					29 01 00 00 00 00 02 bb 00
					29 01 00 00 00 00 02 bc 94
					29 01 00 00 00 00 02 bd 00
					29 01 00 00 00 00 02 be a5
					29 01 00 00 00 00 02 bf 00
					29 01 00 00 00 00 02 c0 b3
					29 01 00 00 00 00 02 c1 00
					29 01 00 00 00 00 02 c2 c1
					29 01 00 00 00 00 02 c3 00
					29 01 00 00 00 00 02 c4 cd
					29 01 00 00 00 00 02 c5 00
					29 01 00 00 00 00 02 c6 f9
					29 01 00 00 00 00 02 c7 01
					29 01 00 00 00 00 02 c8 1f
					29 01 00 00 00 00 02 c9 01
					29 01 00 00 00 00 02 ca 59
					29 01 00 00 00 00 02 cb 01
					29 01 00 00 00 00 02 cc 85
					29 01 00 00 00 00 02 cd 01
					29 01 00 00 00 00 02 ce d1
					29 01 00 00 00 00 02 cf 02
					29 01 00 00 00 00 02 d0 0c
					29 01 00 00 00 00 02 d1 02
					29 01 00 00 00 00 02 d2 0e
					29 01 00 00 00 00 02 d3 02
					29 01 00 00 00 00 02 d4 44
					29 01 00 00 00 00 02 d5 02
					29 01 00 00 00 00 02 d6 80
					29 01 00 00 00 00 02 d7 02
					29 01 00 00 00 00 02 d8 a6
					29 01 00 00 00 00 02 d9 02
					29 01 00 00 00 00 02 da d3
					29 01 00 00 00 00 02 db 02
					29 01 00 00 00 00 02 dc f4
					29 01 00 00 00 00 02 dd 03
					29 01 00 00 00 00 02 de 1e
					29 01 00 00 00 00 02 df 03
					29 01 00 00 00 00 02 e0 29
					29 01 00 00 00 00 02 e1 03
					29 01 00 00 00 00 02 e2 36
					29 01 00 00 00 00 02 e3 03
					29 01 00 00 00 00 02 e4 44
					29 01 00 00 00 00 02 e5 03
					29 01 00 00 00 00 02 e6 57
					29 01 00 00 00 00 02 e7 03
					29 01 00 00 00 00 02 e8 68
					29 01 00 00 00 00 02 e9 03
					29 01 00 00 00 00 02 ea 7a
					29 01 00 00 00 00 02 eb 03
					29 01 00 00 00 00 02 ec 89
					29 01 00 00 00 00 02 ed 03
					29 01 00 00 00 00 02 ee 95
					29 01 00 00 00 00 02 ef 00
					29 01 00 00 00 00 02 f0 42
					29 01 00 00 00 00 02 f1 00
					29 01 00 00 00 00 02 f2 51
					29 01 00 00 00 00 02 f3 00
					29 01 00 00 00 00 02 f4 6b
					29 01 00 00 00 00 02 f5 00
					29 01 00 00 00 00 02 f6 81
					29 01 00 00 00 00 02 f7 00
					29 01 00 00 00 00 02 f8 94
					29 01 00 00 00 00 02 f9 00
					29 01 00 00 00 00 02 fa a5
					29 01 00 00 00 00 02 ff 02
					29 01 00 00 00 00 02 00 00
					29 01 00 00 00 00 02 01 b3
					29 01 00 00 00 00 02 02 00
					29 01 00 00 00 00 02 03 c1
					29 01 00 00 00 00 02 04 00
					29 01 00 00 00 00 02 05 cd
					29 01 00 00 00 00 02 06 00
					29 01 00 00 00 00 02 07 f9
					29 01 00 00 00 00 02 08 01
					29 01 00 00 00 00 02 09 1f
					29 01 00 00 00 00 02 0a 01
					29 01 00 00 00 00 02 0b 59
					29 01 00 00 00 00 02 0c 01
					29 01 00 00 00 00 02 0d 85
					29 01 00 00 00 00 02 0e 01
					29 01 00 00 00 00 02 0f d1
					29 01 00 00 00 00 02 10 02
					29 01 00 00 00 00 02 11 0c
					29 01 00 00 00 00 02 12 02
					29 01 00 00 00 00 02 13 0e
					29 01 00 00 00 00 02 14 02
					29 01 00 00 00 00 02 15 44
					29 01 00 00 00 00 02 16 02
					29 01 00 00 00 00 02 17 80
					29 01 00 00 00 00 02 18 02
					29 01 00 00 00 00 02 19 a6
					29 01 00 00 00 00 02 1a 02
					29 01 00 00 00 00 02 1b d3
					29 01 00 00 00 00 02 1c 02
					29 01 00 00 00 00 02 1d f4
					29 01 00 00 00 00 02 1e 03
					29 01 00 00 00 00 02 1f 1e
					29 01 00 00 00 00 02 20 03
					29 01 00 00 00 00 02 21 29
					29 01 00 00 00 00 02 22 03
					29 01 00 00 00 00 02 23 36
					29 01 00 00 00 00 02 24 03
					29 01 00 00 00 00 02 25 44
					29 01 00 00 00 00 02 26 03
					29 01 00 00 00 00 02 27 57
					29 01 00 00 00 00 02 28 03
					29 01 00 00 00 00 02 29 68
					29 01 00 00 00 00 02 2a 03
					29 01 00 00 00 00 02 2b 7a
					29 01 00 00 00 00 02 2d 03
					29 01 00 00 00 00 02 2f 89
					29 01 00 00 00 00 02 30 03
					29 01 00 00 00 00 02 31 95
					29 01 00 00 00 00 02 32 00
					29 01 00 00 00 00 02 33 42
					29 01 00 00 00 00 02 34 00
					29 01 00 00 00 00 02 35 51
					29 01 00 00 00 00 02 36 00
					29 01 00 00 00 00 02 37 6b
					29 01 00 00 00 00 02 38 00
					29 01 00 00 00 00 02 39 81
					29 01 00 00 00 00 02 3a 00
					29 01 00 00 00 00 02 3b 94
					29 01 00 00 00 00 02 3d 00
					29 01 00 00 00 00 02 3f a5
					29 01 00 00 00 00 02 40 00
					29 01 00 00 00 00 02 41 b3
					29 01 00 00 00 00 02 42 00
					29 01 00 00 00 00 02 43 c1
					29 01 00 00 00 00 02 44 00
					29 01 00 00 00 00 02 45 cd
					29 01 00 00 00 00 02 46 00
					29 01 00 00 00 00 02 47 f9
					29 01 00 00 00 00 02 48 01
					29 01 00 00 00 00 02 49 1f
					29 01 00 00 00 00 02 4a 01
					29 01 00 00 00 00 02 4b 59
					29 01 00 00 00 00 02 4c 01
					29 01 00 00 00 00 02 4d 85
					29 01 00 00 00 00 02 4e 01
					29 01 00 00 00 00 02 4f d1
					29 01 00 00 00 00 02 50 02
					29 01 00 00 00 00 02 51 0c
					29 01 00 00 00 00 02 52 02
					29 01 00 00 00 00 02 53 0e
					29 01 00 00 00 00 02 54 02
					29 01 00 00 00 00 02 55 44
					29 01 00 00 00 00 02 56 02
					29 01 00 00 00 00 02 58 80
					29 01 00 00 00 00 02 59 02
					29 01 00 00 00 00 02 5a a6
					29 01 00 00 00 00 02 5b 02
					29 01 00 00 00 00 02 5c d3
					29 01 00 00 00 00 02 5d 02
					29 01 00 00 00 00 02 5e f4
					29 01 00 00 00 00 02 5f 03
					29 01 00 00 00 00 02 60 1e
					29 01 00 00 00 00 02 61 03
					29 01 00 00 00 00 02 62 29
					29 01 00 00 00 00 02 63 03
					29 01 00 00 00 00 02 64 36
					29 01 00 00 00 00 02 65 03
					29 01 00 00 00 00 02 66 44
					29 01 00 00 00 00 02 67 03
					29 01 00 00 00 00 02 68 57
					29 01 00 00 00 00 02 69 03
					29 01 00 00 00 00 02 6a 68
					29 01 00 00 00 00 02 6b 03
					29 01 00 00 00 00 02 6c 7a
					29 01 00 00 00 00 02 6d 03
					29 01 00 00 00 00 02 6e 89
					29 01 00 00 00 00 02 6f 03
					29 01 00 00 00 00 02 70 95
					29 01 00 00 00 00 02 71 00
					29 01 00 00 00 00 02 72 42
					29 01 00 00 00 00 02 73 00
					29 01 00 00 00 00 02 74 51
					29 01 00 00 00 00 02 75 00
					29 01 00 00 00 00 02 76 6b
					29 01 00 00 00 00 02 77 00
					29 01 00 00 00 00 02 78 81
					29 01 00 00 00 00 02 79 00
					29 01 00 00 00 00 02 7a 94
					29 01 00 00 00 00 02 7b 00
					29 01 00 00 00 00 02 7c a5
					29 01 00 00 00 00 02 7d 00
					29 01 00 00 00 00 02 7e b3
					29 01 00 00 00 00 02 7f 00
					29 01 00 00 00 00 02 80 c1
					29 01 00 00 00 00 02 81 00
					29 01 00 00 00 00 02 82 cd
					29 01 00 00 00 00 02 83 00
					29 01 00 00 00 00 02 84 f9
					29 01 00 00 00 00 02 85 01
					29 01 00 00 00 00 02 86 1f
					29 01 00 00 00 00 02 87 01
					29 01 00 00 00 00 02 88 59
					29 01 00 00 00 00 02 89 01
					29 01 00 00 00 00 02 8a 85
					29 01 00 00 00 00 02 8b 01
					29 01 00 00 00 00 02 8c d1
					29 01 00 00 00 00 02 8d 02
					29 01 00 00 00 00 02 8e 0c
					29 01 00 00 00 00 02 8f 02
					29 01 00 00 00 00 02 90 0e
					29 01 00 00 00 00 02 91 02
					29 01 00 00 00 00 02 92 44
					29 01 00 00 00 00 02 93 02
					29 01 00 00 00 00 02 94 80
					29 01 00 00 00 00 02 95 02
					29 01 00 00 00 00 02 96 a6
					29 01 00 00 00 00 02 97 02
					29 01 00 00 00 00 02 98 d3
					29 01 00 00 00 00 02 99 02
					29 01 00 00 00 00 02 9a f4
					29 01 00 00 00 00 02 9b 03
					29 01 00 00 00 00 02 9c 1e
					29 01 00 00 00 00 02 9d 03
					29 01 00 00 00 00 02 9e 29
					29 01 00 00 00 00 02 9f 03
					29 01 00 00 00 00 02 a0 36
					29 01 00 00 00 00 02 a2 03
					29 01 00 00 00 00 02 a3 44
					29 01 00 00 00 00 02 a4 03
					29 01 00 00 00 00 02 a5 57
					29 01 00 00 00 00 02 a6 03
					29 01 00 00 00 00 02 a7 68
					29 01 00 00 00 00 02 a9 03
					29 01 00 00 00 00 02 aa 7a
					29 01 00 00 00 00 02 ab 03
					29 01 00 00 00 00 02 ac 89
					29 01 00 00 00 00 02 ad 03
					29 01 00 00 00 00 02 ae 95
					29 01 00 00 00 00 02 af 00
					29 01 00 00 00 00 02 b0 42
					29 01 00 00 00 00 02 b1 00
					29 01 00 00 00 00 02 b2 51
					29 01 00 00 00 00 02 b3 00
					29 01 00 00 00 00 02 b4 6b
					29 01 00 00 00 00 02 b5 00
					29 01 00 00 00 00 02 b6 81
					29 01 00 00 00 00 02 b7 00
					29 01 00 00 00 00 02 b8 94
					29 01 00 00 00 00 02 b9 00
					29 01 00 00 00 00 02 ba a5
					29 01 00 00 00 00 02 bb 00
					29 01 00 00 00 00 02 bc b3
					29 01 00 00 00 00 02 bd 00
					29 01 00 00 00 00 02 be c1
					29 01 00 00 00 00 02 bf 00
					29 01 00 00 00 00 02 c0 cd
					29 01 00 00 00 00 02 c1 00
					29 01 00 00 00 00 02 c2 f9
					29 01 00 00 00 00 02 c3 01
					29 01 00 00 00 00 02 c4 1f
					29 01 00 00 00 00 02 c5 01
					29 01 00 00 00 00 02 c6 59
					29 01 00 00 00 00 02 c7 01
					29 01 00 00 00 00 02 c8 85
					29 01 00 00 00 00 02 c9 01
					29 01 00 00 00 00 02 ca d1
					29 01 00 00 00 00 02 cb 02
					29 01 00 00 00 00 02 cc 0c
					29 01 00 00 00 00 02 cd 02
					29 01 00 00 00 00 02 ce 0e
					29 01 00 00 00 00 02 cf 02
					29 01 00 00 00 00 02 d0 44
					29 01 00 00 00 00 02 d1 02
					29 01 00 00 00 00 02 d2 80
					29 01 00 00 00 00 02 d3 02
					29 01 00 00 00 00 02 d4 a6
					29 01 00 00 00 00 02 d5 02
					29 01 00 00 00 00 02 d6 d3
					29 01 00 00 00 00 02 d7 02
					29 01 00 00 00 00 02 d8 f4
					29 01 00 00 00 00 02 d9 03
					29 01 00 00 00 00 02 da 1e
					29 01 00 00 00 00 02 db 03
					29 01 00 00 00 00 02 dc 29
					29 01 00 00 00 00 02 dd 03
					29 01 00 00 00 00 02 de 36
					29 01 00 00 00 00 02 df 03
					29 01 00 00 00 00 02 e0 44
					29 01 00 00 00 00 02 e1 03
					29 01 00 00 00 00 02 e2 57
					29 01 00 00 00 00 02 e3 03
					29 01 00 00 00 00 02 e4 68
					29 01 00 00 00 00 02 e5 03
					29 01 00 00 00 00 02 e6 7a
					29 01 00 00 00 00 02 e7 03
					29 01 00 00 00 00 02 e8 89
					29 01 00 00 00 00 02 e9 03
					29 01 00 00 00 00 02 ea 95
					29 01 00 00 00 00 02 ff 00
					29 01 00 00 00 00 02 fb 01
					29 01 00 00 00 00 02 ff 01
					29 01 00 00 00 00 02 fb 01
					29 01 00 00 00 00 02 ff 02
					29 01 00 00 00 00 02 fb 01
					29 01 00 00 00 00 02 ff 03
					29 01 00 00 00 00 02 fb 01
					29 01 00 00 00 00 02 ff 04
					29 01 00 00 00 00 02 09 20
					29 01 00 00 00 00 02 0a 04
					29 01 00 00 00 00 02 fb 01
					29 01 00 00 00 00 02 ff 05
					29 01 00 00 00 00 02 fb 01
					29 01 00 00 00 00 02 ff 00
					29 01 00 00 78 00 02 11 00
					29 01 00 00 00 00 02 51 ff
					29 01 00 00 00 00 02 53 2c
					29 01 00 00 00 00 02 55 00
					29 01 00 00 00 00 02 29 00
					29 01 00 00 00 00 02 ff 00
					29 01 00 00 14 00 02 35 00
					29 01 00 00 78 00 02 53 2c];
		qcom,mdss-dsi-off-command = [05 01 00 00 32 00 02 28 00
					05 01 00 00 78 00 02 10 00];
		qcom,mdss-dsi-on-command-state = "dsi_lp_mode";
		qcom,mdss-dsi-off-command-state = "dsi_hs_mode";
		qcom,mdss-dsi-panel-status-check-mode = "bta_check";
		qcom,dynamic-mode-switch-enabled;
		qcom,video-to-cmd-mode-switch-commands = [15 01 00 00 14 00 02 C2 0B
					15 01 00 00 00 00 02 C2 08];
		qcom,cmd-to-video-mode-switch-commands = [15 01 00 00 00 00 02 C2 03];
		qcom,mdss-dsi-h-sync-pulse = <1>;
		qcom,mdss-dsi-traffic-mode = "burst_mode";
		qcom,mdss-dsi-bllp-eof-power-mode;
		qcom,mdss-dsi-bllp-power-mode;
		qcom,mdss-dsi-lane-0-state;
		qcom,mdss-dsi-lane-1-state;
		qcom,mdss-dsi-lane-2-state;
		qcom,mdss-dsi-lane-3-state;
		qcom,mdss-dsi-panel-timings = [7d 25 1d 00 37 33 22 27 1e 03 04 00];
		qcom,mdss-dsi-t-clk-post = <0x20>;
		qcom,mdss-dsi-t-clk-pre = <0x2c>;
		qcom,mdss-dsi-bl-min-level = <10>;
		qcom,mdss-dsi-bl-max-level = <160>;
		qcom,mdss-dsi-dma-trigger = "trigger_sw";
		qcom,mdss-dsi-mdp-trigger = "none";
		qcom,mdss-dsi-bl-pmic-control-type = "bl_ctrl_dcs";
		qcom,mdss-dsi-reset-sequence = <1 20>, <0 1>, <1 20>;
		qcom,mdss-pan-physical-width-dimension = <59>;
		qcom,mdss-pan-physical-height-dimension = <104>;
		qcom,mdss-dsi-pan-enable-dynamic-fps;
		qcom,mdss-dsi-pan-fps-update = "dfps_immediate_porch_mode";
		qcom,mdss-dsi-min-refresh-rate = <45>;
		qcom,cont-splash-enabled;
	};
};
